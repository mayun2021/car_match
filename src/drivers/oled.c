/**
 * @file oled.c
 * @brief SSD1306 128x64 I2C OLED 显示驱动实现。
 *
 * 使用水平寻址模式，每次 oled_flush() 把整屏帧缓冲通过 I2C 发送给屏幕。
 * 字库为标准 8x8 点阵（来源 font8x8_basic，Public Domain，基于 IBM VGA
 * 字库），只保留可打印 ASCII 0x20-0x7E 这一段，足够显示遥测数字和字母。
 */

#include "oled.h"
#include "hal.h"
#include "robot_config.h"

#include <string.h>

#define OLED_CTRL_CMD  0x00u
#define OLED_CTRL_DATA 0x40u

/** 按页存储的帧缓冲：s_fb[page][x]，bit0-bit7 对应该页内从上到下 8 行。 */
static uint8_t s_fb[OLED_PAGES][OLED_WIDTH];

/**
 * 8x8 点阵字库，覆盖可打印 ASCII 0x20-0x7E，逐列取模（bit0=最左列）。
 * 来源：font8x8_basic（Public Domain，基于 IBM VGA 字库），仅摘取本工程
 * 需要的可打印范围，索引 = 字符 ASCII 码 - 0x20。
 */
static const uint8_t s_font8x8[95][8] = {
    { 0x00u, 0x00u, 0x00u, 0x00u, 0x00u, 0x00u, 0x00u, 0x00u },  /* 0x20 ' ' */
    { 0x18u, 0x3Cu, 0x3Cu, 0x18u, 0x18u, 0x00u, 0x18u, 0x00u },  /* 0x21 '!' */
    { 0x36u, 0x36u, 0x00u, 0x00u, 0x00u, 0x00u, 0x00u, 0x00u },  /* 0x22 '"' */
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    { 0x6Eu, 0x3Bu, 0x00u, 0x00u, 0x00u, 0x00u, 0x00u, 0x00u },  /* 0x7E '~' */
};

/**
 * @brief 发送单个 SSD1306 命令字节。
 *
 * @param cmd 命令字节。
 * @return true 表示 I2C 写入成功。
 */
static bool oled_write_cmd(uint8_t cmd)
{
    uint8_t buf[2] = { OLED_CTRL_CMD, cmd };
    return hal_i2c_write(ROBOT_OLED_I2C_ADDR, buf, sizeof(buf));
}

/**
 * @brief 初始化 SSD1306：标准命令序列 + 水平寻址模式，并清屏刷新一次。
 */
void oled_init(void)
{
    static const uint8_t init_cmds[] = {
        0xAEu,          /* 关闭显示 */
        0xD5u, 0x80u,   /* 时钟分频 */
        0xA8u, 0x3Fu,   /* 多路复用比 1/64 */
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        0xAFu,          /* 开启显示 */
    };

    for (size_t i = 0; i < sizeof(init_cmds); ++i)
    {
        (void)oled_write_cmd(init_cmds[i]);
    }

    oled_clear();
    oled_flush();
}

/**
 * @brief 清空内部帧缓冲。
 */
void oled_clear(void)
{
    memset(s_fb, 0, sizeof(s_fb));
}

/**
 * @brief 在帧缓冲中设置/清除单个像素。
 *
 * @param x 像素 x 坐标，0-127。
 * @param y 像素 y 坐标，0-63。
 * @param on true 点亮，false 熄灭。
 */
static void oled_set_pixel(uint8_t x, uint8_t y, bool on)
{
    uint8_t page;
    uint8_t bit;

    if (x >= OLED_WIDTH || y >= OLED_HEIGHT)
    {
        return;
    }

    page = (uint8_t)(y / 8u);
    bit = (uint8_t)(y % 8u);

    if (on)
    {
        s_fb[page][x] |= (uint8_t)(1u << bit);
    }
    else
    {
        s_fb[page][x] &= (uint8_t)~(1u << bit);
    }
}

/**
 * @brief 画一个 8x8 点阵字符。
 *
 * @param x 字符左上角 x 坐标。
 * @param y 字符左上角 y 坐标。
 * @param c 可打印 ASCII 字符，超出范围按空格处理。
 */
void oled_draw_char(uint8_t x, uint8_t y, char c)
{
    const uint8_t *glyph;
    uint8_t row;
    uint8_t col;

    if ((uint8_t)c < 0x20u || (uint8_t)c > 0x7Eu)
    {
        c = ' ';
    }

    glyph = s_font8x8[(uint8_t)c - 0x20u];

    for (row = 0; row < 8u; ++row)
    {
        uint8_t bits = glyph[row];

        for (col = 0; col < 8u; ++col)
        {
            if ((bits >> col) & 1u)
            {
                oled_set_pixel((uint8_t)(x + col), (uint8_t)(y + row), true);
            }
        }
    }
}

/**
 * @brief 从指定坐标画一行文本，超出屏幕宽度的部分自动截断。
 *
 * @param x 起始 x 坐标。
 * @param y 起始 y 坐标。
 * @param text 以 '\0' 结尾的 ASCII 字符串。
 */
void oled_draw_string(uint8_t x, uint8_t y, const char *text)
{
    uint8_t cursor = x;

    while (*text != '\0' && (uint16_t)cursor + 8u <= OLED_WIDTH)
    {
        oled_draw_char(cursor, y, *text);
        cursor = (uint8_t)(cursor + 8u);
        text++;
    }
}

/**
 * @brief 把整屏帧缓冲通过 I2C 发送给 SSD1306（水平寻址模式，逐页发送）。
 */
void oled_flush(void)
{
    static const uint8_t addr_window[] = {
        OLED_CTRL_CMD,
        0x21u, 0x00u, (uint8_t)(OLED_WIDTH - 1u),  /* 列地址范围 0..127 */
        0x22u, 0x00u, (uint8_t)(OLED_PAGES - 1u),  /* 页地址范围 0..7 */
    };
    uint8_t page;

    (void)hal_i2c_write(ROBOT_OLED_I2C_ADDR, addr_window, sizeof(addr_window));

    for (page = 0; page < OLED_PAGES; ++page)
    {
        uint8_t buf[1 + OLED_WIDTH];

        buf[0] = OLED_CTRL_DATA;
        memcpy(&buf[1], s_fb[page], OLED_WIDTH);
        (void)hal_i2c_write(ROBOT_OLED_I2C_ADDR, buf, sizeof(buf));
    }
}

/**
 * @brief 获取内部帧缓冲只读指针，供仿真/测试离线渲染核对排版用。
 *
 * @return 指向帧缓冲首字节的指针。
 */
const uint8_t *oled_get_framebuffer(void)
{
    return &s_fb[0][0];
}
